## Kconfig
```kconfig
config MTK_GMP109
	bool "GMP109 for MediaTek package"
	default n
	help
	  It support different type sensor
	  in this platform. If this option
	  is set, it will support pressure
	  GMP109.
```
